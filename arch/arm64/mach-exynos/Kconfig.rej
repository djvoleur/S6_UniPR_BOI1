## arch/arm64/mach-exynos/Kconfig.rej
```kconfig
--- arch/arm64/mach-exynos/Kconfig
+++ arch/arm64/mach-exynos/Kconfig
@@ -79,18 +55,10 @@
 
 config EXYNOS5_DYNAMIC_CPU_HOTPLUG
 	bool "Dynamic CPU Hotplug support"
-	depends on !SOC_EXYNOS7580
 	depends on CPU_FREQ
 	help
 		Enable Dynamic CPU Hotplug
 
-config EXYNOS7580_DYNAMIC_CLUSTER_HOTPLUG
-	bool "Dynamic CLUSTER Hotplug support"
-	depends on SOC_EXYNOS7580
-	depends on CPU_FREQ
-	help
-		Enable Dynamic CLUSTER Hotplug
-
 config EXYNOS_CONTENT_PATH_PROTECTION
 	bool "Exynos Content Path Protection"
 	depends on ARM_TRUSTZONE
```
